## config/west.yml
```yaml
manifest:
    remotes:
        - name: zmkfirmware
          url-base: https://github.com/zmkfirmware
        - name: urob
          url-base: https://github.com/urob
        - name: AceofStades
          url-base: https://github.com/AceofStades
    projects:
        - name: zmk
          remote: zmkfirmware
          revision: v0.3.0
          import: app/west.yml
        - name: zmk-helpers
          remote: urob
          revision: main
        - name: zmk-nice-oled
          remote: AceofStades
          revision: M165437
    self:
        path: config
```
